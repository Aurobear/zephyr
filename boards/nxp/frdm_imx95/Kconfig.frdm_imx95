## boards/nxp/frdm_imx95/Kconfig.frdm_imx95
```kconfig
# SPDX-License-Identifier: Apache-2.0

config BOARD_FRDM_IMX95
	select SOC_MIMX9596_M7 if BOARD_FRDM_IMX95_MIMX9596_M7
	select SOC_PART_NUMBER_MIMX9596AVZXN
```

## boards/nxp/frdm_imx95/board.yml
```yaml
board:
  name: frdm_imx95
  full_name: FRDM i.MX95
  vendor: nxp
  socs:
  - name: mimx9596
```
